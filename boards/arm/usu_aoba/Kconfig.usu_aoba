## boards/arm/usu_aoba/Kconfig.usu_aoba
```kconfig
# SPDX-License-Identifier: MIT

config BOARD_USU_AOBA
    select SOC_NRF52840_QIAA
    imply RETAINED_MEM
    imply RETENTION
    imply RETENTION_BOOT_MODE
```

## boards/arm/usu_aoba/board.yml
```yaml
board:
  name: usu_aoba
  vendor: sekigon
  socs:
    - name: nrf52840
  revision:
    format: major.minor.patch
    default: 0.0.0
    revisions:
      - name: 0.0.0
      - name: 1.0.0
```
